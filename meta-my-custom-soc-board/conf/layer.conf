## meta-my-custom-soc-board/conf/layer.conf
```bitbake
# We have a conf and classes directory, append to BBPATH
BBPATH .= ":${LAYERDIR}"

# We have a recipes directory, add to BBFILES
BBFILES += "${LAYERDIR}/recipes*/*/*.bb \
            ${LAYERDIR}/recipes*/*/*.bbappend"

BBFILE_COLLECTIONS += "meta-my-custom-soc-board"
BBFILE_PATTERN_meta-my-custom-soc-board := "^${LAYERDIR}/"
BBFILE_PRIORITY_meta-my-custom-soc-board = "7"
LAYERSERIES_COMPAT_meta-my-custom-soc-board = "warrior"
```

## meta-my-custom-soc-board/conf/machine/my-custom-soc-board.conf
```bitbake
#@TYPE: Machine
#@NAME: my-custom-soc-board
#@DESCRIPTION: Machine configuration for my custom board"

require conf/machine/include/socfpga.inc

UBOOT_CONFIG ??= "my-custom-soc-board"
UBOOT_CONFIG[my-custom-soc-board] = "socfpga_my_custom_soc_board_defconfig"

KMACHINE = "my-custom-soc-board"

# Default FPGA image
FPGA_CONFIG ?= "\
			soc_system.rbf \
			" 

# Default kernel devicetrees
KERNEL_DEVICETREE ?= "\
			socfpga_cyclone5_my_custom_soc_board.dtb \
			"

SERIAL_CONSOLES ?= "115200;ttyS0"

UBOOT_EXTLINUX ?= "1"
UBOOT_EXTLINUX_LABELS ?= "default"
UBOOT_EXTLINUX_DEFAULT_LABEL ?= "my custom soc board"

UBOOT_EXTLINUX_FDT_default ?= "../socfpga_cyclone5_my_custom_soc_board.dtb"
UBOOT_EXTLINUX_ROOT_default ?= "root=/dev/mmcblk0p3"
UBOOT_EXTLINUX_MENU_DESCRIPTION_default ?= "my custom soc board"
UBOOT_EXTLINUX_KERNEL_IMAGE_default ?= "../${KERNEL_IMAGETYPE}"
UBOOT_EXTLINUX_FDTDIR_default ?= "../"
UBOOT_EXTLINUX_KERNEL_ARGS_default ?= "rootwait rw earlycon"

IMAGE_BOOT_FILES ?= " \
	${FPGA_CONFIG} \
	${KERNEL_DEVICETREE} \
	${KERNEL_IMAGETYPE} \
	extlinux.conf;extlinux/extlinux.conf \
	"

WKS_FILE ?= "sdimage-cyclone5-arria5.wks"
IMAGE_FSTYPES +="wic"
```
